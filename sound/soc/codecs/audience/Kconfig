## sound/soc/codecs/audience/Kconfig
```kconfig
if SND_SOC_ES705
menu "eS705 Bus Interface"

config SND_SOC_ES705_SLIM
	tristate "SLIMbus" if SLIMBUS

config SND_SOC_ES705_I2C
	tristate "I2C command bus"

config SND_SOC_ES705_SPI
	tristate "SPI command bus"

config SND_SOC_ES705_UART
	tristate "UART command transport"

config SND_SOC_ES705_I2S
	tristate "I2S audio data bus"

endmenu
endif

config SND_SOC_ES704_TEMP
	tristate "ES704 Slimbus interface temporally"

config SND_SOC_ES515
        tristate "eS515"
        ---help---
        Valid configurations:
         * SLIMbus
         * I2C and I2S
         * SPI and I2S
         * UART and I2S

        NOTE: Only one configuration should be enabled.

if SND_SOC_ES515
menu "eS515 Bus Interface"

choice
        prompt "earSmart control interface"
        depends on SND_SOC_ES_515
        default SND_SOC_ES_SLIM
        help
          Select either I2C or SLIMBUS for control interface. The currnet
          possible control and data bus selections are:
          * I2C for control - I2S for data
          * SLIMbus for control -I2S for data
          * SLIMbus(for both, control and data interface)

config SND_SOC_ES_SLIM
	tristate "SLIMbus" if SLIMBUS
        ---help---
	  Y to use the SLIMbus as the command and control path

config SND_SOC_ES_I2C
	tristate "I2C command bus"
        ---help---
	 Y to use the I2C as control interface to communicate with
	  Audience chips.

endchoice

config SND_SOC_ES_SPI
	tristate "SPI command bus"

config SND_SOC_ES_UART
	tristate "UART command transport"

config SND_SOC_ES_I2S
	tristate "I2S audio data bus"

endmenu
endif

config SND_SOC_ES_CDEV
        tristate "Character device interface for eS515"
        ---help---
	The character device interface allows the streaming out the audio
	data through selected Bus interface.
```
